## meta-opencalc/conf/layer.conf
```bitbake
# We have a conf and classes directory, add to BBPATH
BBPATH := "${BBPATH}:${LAYERDIR}"

# We have a packages directory, add to BBFILES
BBFILES := "${BBFILES} ${LAYERDIR}/recipes/*/*.bb \
            ${LAYERDIR}/recipes/*/*.bbappend"

BBFILE_COLLECTIONS += "opencalc"
BBFILE_PATTERN_opencalc := "^${LAYERDIR}/"
BBFILE_PRIORITY_opencalc = "99"
```

## meta-opencalc/conf/machine/oc1.conf
```bitbake
#@TYPE: Machine
#@NAME: OC1 machine
#@DESCRIPTION: Machine configuration for the http://opencalc.me/ board 
TARGET_ARCH = "arm"

# Ship all kernel modules by default
MACHINE_EXTRA_RRECOMMENDS = " kernel-modules"

include conf/machine/include/tune-arm926ejs.inc

#DISTRO_FEATURES_LIBC = "ipv4 libc-inet libc-libm libc-libm-big libc-nsswitch libc-locales libc-locale-code libc-posix-clang-wchar"

IMAGE_FSTYPES += "tar.bz2 squashfs"

SERIAL_CONSOLE = "115200 ttyS2"

# TODO import kernel
#PREFERRED_PROVIDER_virtual/kernel ?= "linux-yocto"
#PREFERRED_PROVIDER_linux-libc-headers ?= "linux-libc-headers-yocto"
ASSUME_PROVIDED += "virtual/kernel"

KERNEL_IMAGETYPE = "zImage"

MACHINE_FEATURES = "kernel26 apm usbgadget vfat alsa"

# Pull opencalc head
SRCREV_pn-opencalc = "${AUTOREV}"
```
